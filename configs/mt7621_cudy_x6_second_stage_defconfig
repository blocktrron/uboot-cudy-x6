## configs/mt7621_cudy_x6_second_stage_defconfig
```kconfig
CONFIG_MIPS=y
# CONFIG_SPL is not set
CONFIG_DEBUG_UART_BOARD_INIT=y
CONFIG_DEBUG_UART_BASE=0xbe000c00
CONFIG_DEBUG_UART_CLOCK=50000000
CONFIG_MACH_MT7621=y
CONFIG_BOARD_MT7621_RFB=y
CONFIG_DEFAULT_NOR_KERNEL_OFFSET=0x90000
CONFIG_ROM_EXCEPTION_VECTORS=y
CONFIG_DEBUG_UART=y
CONFIG_MIPS_BOOT_FDT=y
CONFIG_NR_DRAM_BANKS=1
# CONFIG_EXPERT is not set
CONFIG_FIT=y
# CONFIG_ARCH_FIXUP_FDT_MEMORY is not set
CONFIG_SPI_BOOT=y
CONFIG_BOOTDELAY=0
CONFIG_USE_BOOTCOMMAND=y
CONFIG_BOOTCOMMAND="mtkautoboot"
CONFIG_SKIP_LOWLEVEL_INIT=y
CONFIG_DISPLAY_CPUINFO=y
CONFIG_DISPLAY_BOARDINFO=y
# CONFIG_TPL is not set
CONFIG_SYS_TEXT_BASE=0x80700000
CONFIG_CMD_BOOTMENU=y
# CONFIG_CMD_ELF is not set
# CONFIG_CMD_XIMG is not set
# CONFIG_CMD_DM is not set
# CONFIG_CMD_FLASH is not set
CONFIG_CMD_GPIO=y
CONFIG_CMD_SF=y
# CONFIG_CMD_NFS is not set
CONFIG_CMD_MTDPARTS=y
CONFIG_MTDIDS_DEFAULT="nor0=raspi"
CONFIG_MTDPARTS_DEFAULT="mtdparts=raspi:192k(vendor-u-boot),64k(vendor-u-boot-env),64k(factory),512k(u-boot),64k(u-boot-env),31680k(firmware),64k(debug),64k(backup),64k(bdinfo)"
# CONFIG_PARTITIONS is not set
CONFIG_OF_CONTROL=y
CONFIG_OF_EMBED=y
CONFIG_DEFAULT_DEVICE_TREE="mt7621_nor_rfb"
CONFIG_ENV_IS_IN_SPI_FLASH=y
CONFIG_ENV_SIZE=0x10000
CONFIG_ENV_OFFSET=0xD0000
CONFIG_ENV_SECT_SIZE=0x10000
CONFIG_NET_RANDOM_ETHADDR=y
# CONFIG_DM_WARN is not set
CONFIG_DM_DEVICE_REMOVE=y
# CONFIG_OF_TRANSLATE is not set
CONFIG_DM_GPIO=y
CONFIG_MT7621_GPIO=y
CONFIG_MTD=y
CONFIG_MTD_PARTITIONS=y
CONFIG_DM_SPI_FLASH=y
CONFIG_SPI_FLASH=y
CONFIG_SPI_FLASH_BAR=y
CONFIG_SPI_FLASH_EON=y
CONFIG_SPI_FLASH_GIGADEVICE=y
CONFIG_SPI_FLASH_ISSI=y
CONFIG_SPI_FLASH_MACRONIX=y
CONFIG_SPI_FLASH_SPANSION=y
CONFIG_SPI_FLASH_STMICRO=y
CONFIG_SPI_FLASH_SST=y
CONFIG_SPI_FLASH_WINBOND=y
# CONFIG_SPI_FLASH_USE_4K_SECTORS is not set
CONFIG_SPI_FLASH_MTD=y
CONFIG_DM_ETH=y
CONFIG_NETDEVICES=y
CONFIG_MT7621_ETH=y
CONFIG_PINCTRL=y
CONFIG_PINCTRL_FULL=y
CONFIG_PINCTRL_GENERIC=y
CONFIG_PINMUX=y
CONFIG_PINCONF=y
CONFIG_PINCTRL_MT7621=y
CONFIG_DM_RESET=y
CONFIG_MT7621_RESET=y
CONFIG_BAUDRATE=115200
CONFIG_DM_SERIAL=y
# CONFIG_TPL_DM_SERIAL is not set
CONFIG_DEBUG_UART_MTK=y
CONFIG_DEBUG_UART_SHIFT=2
CONFIG_MTK_SERIAL=y
CONFIG_SPI=y
CONFIG_DM_SPI=y
CONFIG_MT7621_SPI=y
CONFIG_LZMA=y
```
